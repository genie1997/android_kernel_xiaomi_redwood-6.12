## techpack/Kconfig
```kconfig
menu "Qualcomm techpack drivers"

source "techpack/audio/Kconfig"
source "techpack/dataipa/Kconfig"
source "techpack/datarmnet/Kconfig"
source "techpack/datarmnet-ext/Kconfig"
source "techpack/display/Kconfig"
source "techpack/dsp/Kconfig"
source "techpack/fingerprint/Kconfig"
source "techpack/graphics/Kconfig"
source "techpack/securemsm/Kconfig"
source "techpack/touch/Kconfig"
source "techpack/vibrator/Kconfig"

endmenu
```

## techpack/audio/Kconfig
```kconfig
config SND_EVENT
	tristate "Audio subsystem event notifier"

config MSM_QDSP6_PDR
	tristate "QDSP6 protection domain restart notifications"
	depends on QCOM_PDR_HELPERS

config MSM_QDSP6_SSR
	bool

config MSM_QDSP6_NOTIFIER
	tristate "QDSP6 audio service notifier"
	depends on QCOM_RPROC_COMMON && QCOM_PDR_HELPERS
	select MSM_QDSP6_PDR
	select MSM_QDSP6_SSR

config MSM_QDSP6_APRV2_RPMSG
	tristate "QDSP6 APR v2 over rpmsg"
	depends on RPMSG && QCOM_SCM
	select SND_EVENT
	select MSM_QDSP6_NOTIFIER

config MSM_ADSP_LOADER
	tristate "ADSP loader"
	depends on MSM_QDSP6_APRV2_RPMSG && REMOTEPROC
	help
	  Boots the ADSP when userspace writes /sys/kernel/boot_adsp/boot.

config SND_SOC_LAHAINA
	tristate "Lahaina sound card"
	depends on SND_SOC && MSM_QDSP6_APRV2_RPMSG && QCOM_SCM && PINCTRL_MSM
	help
	  Builds the lahaina sound card the way Qualcomm's lahaina target
	  does: the q6 DSP interface, the ASoC platform and machine drivers,
	  SoundWire, the LPASS pin controller, bolero with its RX, TX and VA
	  macros, the WCD938x codec and the WCD937x and WSA883x codecs the
	  machine driver calls into.

config SND_SOC_AW882XX
	tristate "Awinic AW882xx smart amplifier"
	depends on I2C && SND_SOC_LAHAINA
	help
	  The AW882xx speaker amplifiers on the primary TDM interface, with
	  their calibration through the ADSP.
```

## techpack/bt/Kconfig
```kconfig
config MSM_BT_POWER
	tristate "Qualcomm WCN6750 Bluetooth power control"
	depends on m && ARCH_QCOM && RFKILL
	help
	  btpower.ko: switches the WCN6750 Bluetooth core on and off (its
	  regulators and BT_EN), registers the bt_power rfkill switch and
	  gives the Bluetooth HAL /dev/btpower.

config BTFM_SLIM
	tristate "Qualcomm WCN6750 Bluetooth slimbus audio"
	depends on m && MSM_BT_POWER && SLIMBUS && SND_SOC
	help
	  bt_fm_slim.ko: the btfmslim_slave ASoC codec on the WCN6750
	  slimbus interface, which carries Bluetooth call audio and offloaded
	  A2DP audio between the audio DSP and the Bluetooth core.
```

## techpack/camera/Kconfig
```kconfig
config SPECTRA_CAMERA
	tristate "Camera driver"
	depends on m && MEDIA_CONTROLLER && VIDEO_V4L2_SUBDEV_API && INTERCONNECT_QCOM
	depends on QCOM_SCM && QCOM_SOCINFO && QCOM_IOMMU_UTIL && ION_MSM_HEAPS && LEDS_QTI_FLASH
	help
	  camera.ko: the camera request manager, sync, memory manager, CPAS,
	  CDM, ISP, ICP, JPEG, LRME and the sensor modules (CCI, CSIPHY,
	  sensor, actuator, EEPROM, OIS, flash), built with Qualcomm's
	  config/yupikcameraconf.h.
```

## techpack/dataipa/Kconfig
```kconfig
config GSI
	tristate "GSI support"
	depends on ARCH_QCOM
	help
	  This driver provides the transport needed to talk to the
	  IPA core. It replaces the BAM transport used previously.

	  The GSI connects to a peripheral component via uniform TLV
	  interface, and allows it to interface with other peripherals
	  and CPUs over various types of interfaces such as MHI, xDCI,
	  xHCI, GPI, WDI, Ethernet, etc.

config IPA3
	tristate "IPA3 support"
	depends on NET && GSI
	depends on QCOM_AOSS_QMP && QCOM_IOMMU_UTIL && QCOM_SMEM && QCOM_RPROC_COMMON
	select QCOM_MDT_LOADER
	help
	  This driver supports the Internet Packet Accelerator (IPA3) core.
	  IPA is a programmable protocol processor HW block.
	  It is designed to support generic HW processing of UL/DL IP packets
	  for various use cases independent of radio technology.
	  The driver support client connection and configuration
	  for the IPA core.
	  Kernel and user-space processes can call the IPA driver
	  to configure IPA core.

config RMNET_IPA3
	bool "IPA3 RMNET WWAN Network Device"
	depends on IPA3
	select QCOM_QMI_HELPERS
	help
	  This WWAN Network Driver implements network stack class device.
	  It supports Embedded data transfer from A7 to Q6. Configures IPA HW
	  for RmNet Data Driver and also exchange of QMI messages between
	  A7 and Q6 IPA-driver.

config IPA_RMNET_MEM
	bool "IPA pages from the RmNet memory pool"
	depends on IPA3 && (RMNET_MEM = y || RMNET_MEM = IPA3)
	help
	  The WAN receive pipes that run on pages take their temporary pages
	  from the RmNet memory pool and size their refill by it, so the IPA
	  and the RmNet driver recycle one pool of high order pages.
```

## techpack/datarmnet-ext/Kconfig
```kconfig
config RMNET_MEM
	tristate "RmNet MEM support"
	depends on NET
	help
	  Memory module for RmNet driver
```

## techpack/datarmnet/Kconfig
```kconfig
config RMNET_CORE
	tristate "RmNet MAP driver"
	depends on IPA3 && RMNET_MEM
	depends on RMNET_CTL || !RMNET_LA_PLATFORM
	select GRO_CELLS
	select QCOM_QMI_HELPERS
	help
	  If you select this, you will enable the RMNET module which is used
	  for handling data in the multiplexing and aggregation protocol (MAP)
	  format in the embedded data path. RMNET devices can be attached to
	  any IP mode physical device.

config RMNET_CTL
	tristate "RmNet CTL support"
	depends on IPA3
	help
	  Enable the RMNET CTL module which is used for handling QMAP commands
	  for flow control purposes.

config RMNET_LA_PLATFORM
	bool "RMNET platform support"
	depends on RMNET_CTL
	help
	  Enable the functionality gated by the RMNET_LA_PLATFORM configuration
	  in rmnet driver.
```

## techpack/display/Kconfig
```kconfig
config MSM_DRM
	tristate "Display driver"
	depends on m && DRM && COMMON_CLK_QCOM && PINCTRL_MSM && SPMI_MSM_PMIC_ARB
	depends on QCOM_SCM && QCOM_SOCINFO && QCOM_RPMH && QCOM_LLCC && QCOM_PANEL_EVENT_NOTIFIER
	depends on ION_MSM_HEAPS && QCOM_IOMMU_UTIL && QCOM_LAZY_MAPPING
	help
	  msm_drm: the SDE display engine, the DSI panel path and writeback
	  the vendor composer drives, built with config/redwooddisp.conf.
```

## techpack/dsp/Kconfig
```kconfig
config MSM_CDSP_LOADER
	tristate "CDSP loader"
	depends on REMOTEPROC
	help
	  Boots the CDSP when userspace writes /sys/kernel/boot_cdsp/boot.

config MSM_ADSPRPC
	tristate "QTI FastRPC driver"
	depends on RPMSG && QCOM_SCM && QCOM_SOCINFO && QCOM_PDR_HELPERS && QCOM_RPROC_COMMON
	help
	  Provides a communication mechanism that allows clients to
	  make remote method invocations across processor boundary to
	  applications/compute DSP processor.
	  Say M if you want to enable this module.
```

## techpack/fingerprint/Kconfig
```kconfig
config FINGERPRINT_GOODIX_TEE
	tristate "Goodix fingerprint sensor"
	depends on m && INPUT && NET
	help
	  goodix_tee: /dev/goodix_fp and the netlink channel the Goodix
	  fingerprint HAL uses to power, reset and arm the sensor, whose
	  captures run in TrustZone.

config FINGERPRINT_XIAOMI_FP
	tristate "Xiaomi fingerprint interface"
	depends on m
	help
	  xiaomifp: the fingerdown and actpower nodes of the
	  xiaomi_fingerprint device, which the fingerprint HAL reads.
```

## techpack/sched/Kconfig
```kconfig
# SPDX-License-Identifier: GPL-2.0-only

config SCHED_CASS
	tristate "Capacity Aware Superset Scheduler task placement"
	depends on m && SMP && UCLAMP_TASK_GROUP && CPU_FREQ_GOV_SCHEDUTIL && ANDROID_VENDOR_HOOKS
	help
	  Places CFS and RT tasks with the Capacity Aware Superset Scheduler
	  through the restricted scheduler vendor hooks, so the core scheduler
	  stays as it is. The foreground app (a latency sensitive group) takes
	  the faster idle CPU. Other tasks keep energy aware placement for
	  light wakeups and prefer an idle smaller CPU that fits them. The
	  busy share of the last window keeps a floor under the schedutil
	  clock for streams of short tasks.

config SCHED_SCREEN_IDLE
	tristate "Shallow CPU idle while the panel is on"
	depends on m && QCOM_PANEL_EVENT_NOTIFIER && DRM_PANEL
	help
	  Holds a CPU wakeup latency request while the primary panel is on, so
	  idle CPUs stay in their shallow state and answer a wakeup within
	  microseconds instead of leaving a power collapse. The request drops
	  when the panel blanks or enters low power, which leaves the deep
	  states to standby and always on display.
```

## techpack/securemsm/Kconfig
```kconfig
config QSEECOM
	tristate "QSEECom driver"
	depends on QCOM_SCM && QTEE_SHM_BRIDGE && QCOM_SECURE_BUFFER && ION_MSM_HEAPS
	help
	  /dev/qseecom, through which the vendor libraries load trusted apps
	  and talk to them (keymaster, gatekeeper and the qseecomd listeners).

config CRYPTO_DEV_QCEDEV
	tristate "Qualcomm crypto engine driver"
	depends on SPS && QCOM_SECURE_BUFFER && ION_MSM_HEAPS
	help
	  /dev/qce, the crypto engine the vendor content protection library
	  (libcpion) drives through the BAM DMA of SPS.

config QCOM_SMCINVOKE
	tristate "SMCInvoke driver"
	depends on QCOM_SCM && QTEE_SHM_BRIDGE && QSEECOM && ION_MSM_HEAPS
	help
	  /dev/smcinvoke, the object call channel to QTEE through which the
	  vendor Mink library reaches trusted services: the Widevine license
	  check and trusted app loader, and the TEE services other daemons
	  open (ssgtzd, qteeconnector).
```

## techpack/touch/Kconfig
```kconfig
config TOUCHSCREEN_XIAOMI_TOUCHFEATURE
	tristate "Xiaomi touch interface"
	depends on m && INPUT
	help
	  xiaomi_touch: /dev/xiaomi-touch and the touch class the power HAL
	  uses for double tap to wake. The touch drivers register their modes
	  with it.

config TOUCHSCREEN_GOODIX_BRL
	tristate "Goodix Berlin touchscreen"
	depends on m && SPI && DRM && POWER_SUPPLY && QCOM_PANEL_EVENT_NOTIFIER
	depends on TOUCHSCREEN_XIAOMI_TOUCHFEATURE
	help
	  goodix_ts: the Goodix Berlin-D touch controller on SPI, used by the
	  panels whose ID pins name Goodix.

config TOUCHSCREEN_FOCALTECH_3680
	tristate "FocalTech 3680 touchscreen"
	depends on m && SPI && DRM && POWER_SUPPLY && QCOM_PANEL_EVENT_NOTIFIER
	depends on TOUCHSCREEN_XIAOMI_TOUCHFEATURE
	help
	  focaltech_touch: the FocalTech FT3680 touch controller on SPI, used
	  by the panels whose ID pins name FocalTech.
```

## techpack/vibrator/Kconfig
```kconfig
config AWINIC_VIBRATOR
	tristate "Awinic haptic driver"
	depends on m && I2C && INPUT
	help
	  awinic_haptic: the Awinic high voltage LRA haptic driver on I2C. The
	  vibrator HAL plays timed vibrations, effects and streamed waveforms
	  through the force feedback input device it registers.

config AW869X_DRIVER_ENABLE
	bool "Awinic AW8695/AW8697"
	depends on AWINIC_VIBRATOR
	help
	  The AW869x haptic parts some units carry.

config AW8692X_DRIVER_ENABLE
	bool "Awinic AW86925-AW86928"
	depends on AWINIC_VIBRATOR
	help
	  The AW8692x haptic parts, AW86927 on redwood.
```

## techpack/video/Kconfig
```kconfig
config MSM_VIDC_V4L2
	tristate "Video driver"
	depends on m && VIDEO_DEV && VIDEOBUF2_V4L2 && INTERCONNECT
	depends on QCOM_SCM && QCOM_MDT_LOADER && QCOM_SMEM && QCOM_LLCC && ION_MSM_HEAPS
	help
	  msm-vidc.ko: the V4L2 decoder and encoder of the iris2 video core,
	  with its HFI layer, clock and bus scaling, buffer sizing and the
	  lahaina platform data, as Qualcomm's msm/Makefile builds it.
```

## techpack/wlan/Kconfig
```kconfig
source "techpack/wlan/platform/icnss2/Kconfig"
source "techpack/wlan/platform/cnss_utils/Kconfig"
source "techpack/wlan/platform/cnss_genl/Kconfig"
source "techpack/wlan/platform/cnss_prealloc/Kconfig"

config QCA_CLD_WLAN
	tristate "Qualcomm WCN6750 Wi-Fi host driver"
	depends on m && CFG80211 && ICNSS2 && CNSS_GENL && WCNSS_MEM_PRE_ALLOC && IPA3 && QCOM_IOMMU_UTIL
	help
	  wlan: the qcacld-3.0 cfg80211 driver of the WCN6750 Wi-Fi, which
	  the Wi-Fi HAL loads and switches on and off through /dev/wlan.
```
